/*---------------------------------------------------------------------------*/
/*- Object               : AT91SAM7S64 memory definitions                    */
/*---------------------------------------------------------------------------*/

MEMORY
{
  CODE (rx)  : ORIGIN = 0x00100000, LENGTH = 64k
  DATA (rwx) : ORIGIN = 0x00200000, LENGTH = 16k
}
